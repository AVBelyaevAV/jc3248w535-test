#include "demo_app.h"
#include <math.h>

// 5x7 шрифт ASCII 32..127 (упрощённый, но рабочий)
static const uint8_t font5x7[96][5] = {
    {0x00,0x00,0x00,0x00,0x00}, // ' '
    {0x00,0x00,0x5F,0x00,0x00}, // '!'
    {0x00,0x07,0x00,0x07,0x00}, // '"'
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    {0x08,0x04,0x08,0x10,0x08}  // '~'
};

static const uint16_t palette[] = {
    0xF800, 0x07E0, 0x001F, 0xFFE0, 0xF81F, 0x07FF, 0xFFFF, 0x0000
};

static void drawChar(AXS15231B_QSPI* lcd, uint16_t x, uint16_t y, char c,
                     uint16_t color, uint16_t bg, uint8_t size) {
    if (c < 32 || c > 127) return;
    const uint8_t* glyph = font5x7[c - 32];
    for (uint8_t i = 0; i < 5; i++) {
        uint8_t line = glyph[i];
        for (uint8_t j = 0; j < 8; j++) {
            if (line & (1 << j)) {
                lcd->fillRect(x + i * size, y + j * size, size, size, color);
            } else if (bg != color) {
                lcd->fillRect(x + i * size, y + j * size, size, size, bg);
            }
        }
    }
}

void DemoApp::runPhase(AXS15231B_QSPI* lcd, uint8_t phase) {
    uint16_t W = lcd->width(), H = lcd->height();
    switch (phase % 8) {
    case 0: { // Градиент RGB565
        Serial.println("[DEMO] RGB565 gradient");
        lcd->setWindow(0, 0, W - 1, H - 1);
        uint16_t buf[256];
        for (uint16_t y = 0; y < H; y++) {
            uint8_t r = (y * 31) / H;
            uint8_t g = (y * 63) / H;
            uint8_t b = (y * 31) / H;
            uint16_t c = (r << 11) | (g << 5) | b;
            for (int i = 0; i < 256; i++) buf[i] = c;
            uint32_t left = W;
            while (left > 0) {
                uint16_t n = left > 256 ? 256 : left;
                lcd->pushPixels(buf, n);
                left -= n;
            }
        }
        break;
    }
    case 1: { // Цветные полосы
        Serial.println("[DEMO] Color bars");
        uint16_t bw = W / 8;
        for (int i = 0; i < 8; i++)
            lcd->fillRect(i * bw, 0, bw + 1, H, palette[i]);
        break;
    }
    case 2: { // Сетка
        Serial.println("[DEMO] Grid");
        lcd->fillScreen(0x0000);
        for (int x = 0; x < W; x += 20) lcd->drawLine(x, 0, x, H - 1, 0x07E0);
        for (int y = 0; y < H; y += 20) lcd->drawLine(0, y, W - 1, y, 0x07E0);
        break;
    }
    case 3: { // Круги (заливка через fillRect)
        Serial.println("[DEMO] Circles");
        lcd->fillScreen(0x0000);
        for (int r = 10; r < 200; r += 15) {
            // аппроксимация круга заливкой строк
            int cx = W / 2, cy = H / 2;
            for (int dy = -r; dy <= r; dy++) {
                int dx = (int)sqrt((double)(r * r - dy * dy));
                lcd->fillRect(cx - dx, cy + dy, 2 * dx + 1, 1, palette[(r / 15) % 8]);
            }
        }
        break;
    }
    case 4: { // Инверсия
        Serial.println("[DEMO] Inversion toggle");
        lcd->invertDisplay(true); delay(1000);
        lcd->invertDisplay(false);
        break;
    }
    case 5: { // Rotation test
        Serial.println("[DEMO] Rotation");
        for (uint8_t r = 0; r < 4; r++) {
            lcd->setRotation(r);
            lcd->fillScreen(palette[r]);
            delay(600);
        }
        lcd->setRotation(0);
        break;
    }
    case 6: { // FPS-тест
        Serial.println("[DEMO] Fill speed test");
        uint32_t t0 = micros();
        lcd->fillScreen(0xF800);
        lcd->fillScreen(0x07E0);
        lcd->fillScreen(0x001F);
        lcd->fillScreen(0x0000);
        uint32_t dt = micros() - t0;
        Serial.printf("4 fullscreen fills: %u us (%.1f fps equiv)\n",
                      dt, 4.0f * 1e6f / dt);
        break;
    }
    case 7: { // Текст
        Serial.println("[DEMO] Text");
        lcd->fillScreen(0x0000);
        const char* msg = "AXS15231B";
        for (int i = 0; msg[i]; i++)
            drawChar(lcd, 20 + i * 40, 40, msg[i], 0xFFFF, 0x0000, 4);
        break;
    }
    }
}